## prj.conf
```kconfig
#
# Copyright (c) 2026 Nordic Semiconductor ASA
#
# SPDX-License-Identifier: LicenseRef-Nordic-5-Clause
#

CONFIG_MATTER_ZIGBEE_ADD_ON=y

CONFIG_NCS_SAMPLES_DEFAULTS=y

CONFIG_UART_INTERRUPT_DRIVEN=y
CONFIG_SERIAL=y
CONFIG_GPIO=y

CONFIG_CONSOLE=y
CONFIG_UART_CONSOLE=y

CONFIG_HEAP_MEM_POOL_SIZE=2048
CONFIG_MAIN_STACK_SIZE=10240
CONFIG_MAIN_THREAD_PRIORITY=7

#######################
# Zigbee Configuration
#######################

CONFIG_ZIGBEE_ADD_ON=y
CONFIG_ZIGBEE_APP_UTILS=y
CONFIG_ZIGBEE_APP_UTILS_LOG_LEVEL_INF=y
CONFIG_ZIGBEE_ROLE_END_DEVICE=y

CONFIG_DK_LIBRARY=y

# Touchlink initiator role for the combined Matter build
# CONFIG_ZIGBEE_TOUCHLINK_INITIATOR=y

CONFIG_RAM_POWER_DOWN_LIBRARY=y

CONFIG_ZBOSS_OSIF_LOG_LEVEL_INF=y
CONFIG_MATTER_ZIGBEE_COEXISTENCE_LOG_LEVEL_INF=y

#######################
# Matter Configuration
#######################

CONFIG_CHIP=y
CONFIG_CHIP_PROJECT_CONFIG="include/chip_project_config.h"
CONFIG_CHIP_DEVICE_PRODUCT_NAME="Matter Zigbee Light Switch"

CONFIG_NCS_SAMPLE_MATTER_ZAP_FILE_PATH="${APPLICATION_CONFIG_DIR}/src/default_zap/light_switch.zap"

CONFIG_CHIP_DEVICE_PRODUCT_ID=32772
CONFIG_STD_CPP17=y

CONFIG_CHIP_ENABLE_PAIRING_AUTOSTART=y
CONFIG_CHIP_BLE_EXT_ADVERTISING=y
CONFIG_CHIP_BLE_ADVERTISING_DURATION=60

CONFIG_BT_DEVICE_NAME="MatterZigbeeSw"

CONFIG_THREAD_NAME=y
CONFIG_MPU_STACK_GUARD=y
CONFIG_RESET_ON_FATAL_ERROR=n

# Reduce application size
CONFIG_USE_SEGGER_RTT=n

# Increase system workqueue stack for combined protocols (with Thread)
CONFIG_SYSTEM_WORKQUEUE_STACK_SIZE=6144

# Must be a preemptible priority (0–15), not cooperative (-1). With -1, ZBOSS is
# coop priority -1 and is outranked by MPSL Work (prio -8), so it never runs.
# State 128 = _THREAD_QUEUED (runnable); ZBOSS stays queued and never gets CPU.
CONFIG_ZBOSS_DEFAULT_THREAD_PRIORITY=1
CONFIG_ZBOSS_DEFAULT_THREAD_STACK_SIZE=6144

# Libc malloc arena required for Zigbee + Matter coexistence.
# - 0: no libc heap -> Matter init fails (malloc/calloc used during init).
# - -1: "all remaining RAM" -> on this build the computed heap extends past
#        valid SRAM and faults at first free().
# - Fixed value sized for Matter + Thread + Zigbee (empirical):
#   ~96 KB covers Matter CASE session, Thread buffers, and Zigbee allocations
#   without running the heap off the end of usable SRAM.
CONFIG_COMMON_LIBC_MALLOC_ARENA_SIZE=-1

## PoC Configuration ##
# Keep Matter shell disabled to avoid getopt conflicts
CONFIG_CHIP_LIB_SHELL=n
CONFIG_NCS_SAMPLE_MATTER_TEST_SHELL=n

# Radio dispatcher
CONFIG_NRF_802154_CALLBACKS_DISPATCHER=y
CONFIG_NRF_802154_DRV_REINIT_ENABLED=y

# We need it to disable ZBOSS thread
CONFIG_ZIGBEE_DEBUG_FUNCTIONS=y

CONFIG_CHIP_FACTORY_DATA_BUILD=y

# DFU over Bluetooth LE SMP
CONFIG_CHIP_DFU_OVER_BT_SMP=y
CONFIG_NCS_SAMPLE_MATTER_CUSTOM_BLUETOOTH_ADVERTISING=y
CONFIG_NCS_SAMPLE_MATTER_USE_DEFAULT_BUTTON_HANDLER=n
```

## include/app_task_matter.h
```c
/*
 * Copyright (c) 2026 Nordic Semiconductor ASA
 *
 * SPDX-License-Identifier: LicenseRef-Nordic-5-Clause
 */

#pragma once

#include "board/board.h"

#include <platform/CHIPDeviceLayer.h>

class AppTask {
public:
	static AppTask &Instance()
	{
		static AppTask sAppTask;
		return sAppTask;
	};

	CHIP_ERROR StartApp();

	void UpdateClusterState();

private:
	CHIP_ERROR Init();

	static void ButtonEventHandler(Nrf::ButtonState state, Nrf::ButtonMask hasChanged);
};
```

## src/app_task_matter.cpp
```c
/*
 * Copyright (c) 2026 Nordic Semiconductor ASA
 *
 * SPDX-License-Identifier: LicenseRef-Nordic-5-Clause
 */

#include "app_task_matter.h"

#include "light_switch.h"

#include "app/matter_init.h"
#include "app/task_executor.h"
#include "board/board.h"
#include "clusters/identify.h"

#include <app-common/zap-generated/attributes/Accessors.h>
#include <app/server/Server.h>
#include <setup_payload/OnboardingCodesUtil.h>

#include <matter_zigbee_coexistence.h>
#include <matter_zigbee_ui.h>
#include <matter_zigbee_ui_config.h>
#include <matter_zigbee_ui_led.h>

#include <dk_buttons_and_leds.h>

#include <zephyr/logging/log.h>

LOG_MODULE_DECLARE(app, CONFIG_CHIP_APP_LOG_LEVEL);

using namespace ::chip;
using namespace ::chip::app;
using namespace ::chip::DeviceLayer;

namespace
{
constexpr EndpointId kLightSwitchEndpointId = 1;
constexpr EndpointId kLightEndpointId = 1;

k_timer sLightPressTimer;
k_timer sLightDimTimer;
k_timer sIdentifyPressTimer;
k_timer sIdentifyDimTimer;

bool sLightHoldActive;
bool sIdentifyHoldActive;

class SwitchIdentifyDelegate : public Nrf::Matter::IdentifyDelegateImplNrf {
public:
	SwitchIdentifyDelegate() : IdentifyDelegateImplNrf(false, []() { matter_zigbee_ui_led_zigbee_identify_stop(); })
	{
	}

	void OnIdentifyStart(chip::app::Clusters::IdentifyCluster &cluster) override
	{
		ARG_UNUSED(cluster);
		matter_zigbee_ui_led_zigbee_identify_start();
	}

	void OnIdentifyStop(chip::app::Clusters::IdentifyCluster &cluster) override
	{
		ARG_UNUSED(cluster);
		matter_zigbee_ui_led_zigbee_identify_stop();
	}
};

SwitchIdentifyDelegate sIdentifyDelegate;
Nrf::Matter::IdentifyCluster sIdentifyCluster(kLightEndpointId, sIdentifyDelegate);

void TriggerMatterIdentify()
{
	Clusters::Identify::Attributes::IdentifyTime::Set(kLightEndpointId, 3);
}

void LightDimTimerEventHandler()
{
	LightSwitch::GetInstance().DimmerChangeBrightness(true);
}

void IdentifyDimTimerEventHandler()
{
	LightSwitch::GetInstance().DimmerChangeBrightness(false);
}

void LightPressTimeoutCallback(k_timer *timer)
{
	ARG_UNUSED(timer);

	sLightHoldActive = true;
	k_timer_start(&sLightDimTimer, K_MSEC(MATTER_ZIGBEE_UI_DIM_INTERVAL_MS),
		      K_MSEC(MATTER_ZIGBEE_UI_DIM_INTERVAL_MS));
	Nrf::PostTask([] { LightDimTimerEventHandler(); });
}

void IdentifyPressTimeoutCallback(k_timer *timer)
{
	ARG_UNUSED(timer);

	sIdentifyHoldActive = true;
	k_timer_start(&sIdentifyDimTimer, K_MSEC(MATTER_ZIGBEE_UI_DIM_INTERVAL_MS),
		      K_MSEC(MATTER_ZIGBEE_UI_DIM_INTERVAL_MS));
	Nrf::PostTask([] { IdentifyDimTimerEventHandler(); });
}

void LightDimTimeoutCallback(k_timer *timer)
{
	ARG_UNUSED(timer);
	Nrf::PostTask([] { LightDimTimerEventHandler(); });
}

void IdentifyDimTimeoutCallback(k_timer *timer)
{
	ARG_UNUSED(timer);
	Nrf::PostTask([] { IdentifyDimTimerEventHandler(); });
}

} /* namespace */

void AppTask::ButtonEventHandler(Nrf::ButtonState state, Nrf::ButtonMask hasChanged)
{
#ifdef CONFIG_CHIP_ICD_UAT_SUPPORT
	if ((MATTER_ZIGBEE_UI_BUTTON_PROTOCOL_SWITCH_MSK & state & hasChanged)) {
		LOG_INF("ICD UserActiveMode has been triggered.");
		Server::GetInstance().GetICDManager().OnNetworkActivity();
		return;
	}
#endif

	if (hasChanged & MATTER_ZIGBEE_UI_BUTTON_LIGHT_MSK) {
		if (state & MATTER_ZIGBEE_UI_BUTTON_LIGHT_MSK) {
			sLightHoldActive = false;
			k_timer_start(&sLightPressTimer, K_MSEC(MATTER_ZIGBEE_UI_DIM_HOLD_THRESHOLD_MS), K_NO_WAIT);
		} else {
			k_timer_stop(&sLightPressTimer);
			k_timer_stop(&sLightDimTimer);
			if (!sLightHoldActive) {
				Nrf::PostTask([] {
					LightSwitch::GetInstance().InitiateActionSwitch(LightSwitch::Action::Toggle);
				});
			}
			sLightHoldActive = false;
		}
		return;
	}

	if (hasChanged & MATTER_ZIGBEE_UI_BUTTON_IDENTIFY_MSK) {
		if (state & MATTER_ZIGBEE_UI_BUTTON_IDENTIFY_MSK) {
			sIdentifyHoldActive = false;
			k_timer_start(&sIdentifyPressTimer, K_MSEC(MATTER_ZIGBEE_UI_DIM_HOLD_THRESHOLD_MS), K_NO_WAIT);
		} else {
			k_timer_stop(&sIdentifyPressTimer);
			k_timer_stop(&sIdentifyDimTimer);
			if (!sIdentifyHoldActive) {
				Nrf::PostTask([] { TriggerMatterIdentify(); });
			}
			sIdentifyHoldActive = false;
		}
	}
}

CHIP_ERROR AppTask::Init()
{
	Nrf::Matter::InitData initData{};
	initData.mPostServerInitClbk = [] {
		LightSwitch::GetInstance().Init(kLightSwitchEndpointId);
		return CHIP_NO_ERROR;
	};
	initData.mPreServerInitClbk = []() -> CHIP_ERROR {
		matter_zigbee_coexistence_pre_server_init();
		return CHIP_NO_ERROR;
	};
	ReturnErrorOnFailure(Nrf::Matter::PrepareServer(initData));

	k_timer_init(&sLightPressTimer, LightPressTimeoutCallback, nullptr);
	k_timer_init(&sLightDimTimer, LightDimTimeoutCallback, nullptr);
	k_timer_init(&sIdentifyPressTimer, IdentifyPressTimeoutCallback, nullptr);
	k_timer_init(&sIdentifyDimTimer, IdentifyDimTimeoutCallback, nullptr);

	matter_zigbee_ui_led_init();

	if (!Nrf::GetBoard().Init(ButtonEventHandler)) {
		LOG_ERR("User interface initialization failed.");
		return CHIP_ERROR_INCORRECT_STATE;
	}

	matter_zigbee_ui_button_init();
	matter_zigbee_ui_led_register_matter_events();

	ReturnErrorOnFailure(sIdentifyCluster.Init());
	ReturnErrorOnFailure(Nrf::Matter::StartServer());
	matter_zigbee_coexistence_on_server_started();

	return CHIP_NO_ERROR;
}

CHIP_ERROR AppTask::StartApp()
{
	ReturnErrorOnFailure(Init());

	while (true) {
		Nrf::DispatchNextTask();
	}

	return CHIP_NO_ERROR;
}
```

## src/light_switch.cpp
```c
/*
 * Copyright (c) 2022 Nordic Semiconductor ASA
 *
 * SPDX-License-Identifier: LicenseRef-Nordic-5-Clause
 */

#include "light_switch.h"
#include "binding/binding_handler.h"

#ifdef CONFIG_CHIP_LIB_SHELL
#include "shell_commands.h"
#endif

#include <app/clusters/bindings/binding-table.h>
#include <app/server/Server.h>
#include <controller/InvokeInteraction.h>
#include <platform/CHIPDeviceLayer.h>
#include <zephyr/logging/log.h>

using namespace chip;
using namespace chip::app;
using namespace chip::app::Clusters;

LOG_MODULE_DECLARE(app, CONFIG_CHIP_APP_LOG_LEVEL);

void LightSwitch::Init(chip::EndpointId lightSwitchEndpoint)
{
	Nrf::Matter::BindingHandler::Init();
#ifdef CONFIG_CHIP_LIB_SHELL
	SwitchCommands::RegisterSwitchCommands();
#endif
	mLightSwitchEndpoint = lightSwitchEndpoint;
}

void LightSwitch::InitiateActionSwitch(Action action)
{
	Nrf::Matter::BindingHandler::BindingData *data = Platform::New<Nrf::Matter::BindingHandler::BindingData>();
	if (data) {
		data->EndpointId = mLightSwitchEndpoint;
		data->ClusterId = Clusters::OnOff::Id;
		data->InvokeCommandFunc = SwitchChangedHandler;
		switch (action) {
		case Action::Toggle:
			data->CommandId = Clusters::OnOff::Commands::Toggle::Id;
			break;
		case Action::On:
			data->CommandId = Clusters::OnOff::Commands::On::Id;
			break;
		case Action::Off:
			data->CommandId = Clusters::OnOff::Commands::Off::Id;
			break;
		default:
			Platform::Delete(data);
			return;
		}
		Nrf::Matter::BindingHandler::RunBoundClusterAction(data);
	}
}

void LightSwitch::DimmerChangeBrightness(bool increase)
{
	static uint16_t sBrightness;
	Nrf::Matter::BindingHandler::BindingData *data = Platform::New<Nrf::Matter::BindingHandler::BindingData>();
	if (data) {
		data->EndpointId = mLightSwitchEndpoint;
		data->CommandId = Clusters::LevelControl::Commands::MoveToLevel::Id;
		data->ClusterId = Clusters::LevelControl::Id;
		data->InvokeCommandFunc = SwitchChangedHandler;
		if (increase) {
			sBrightness += kOnePercentBrightnessApproximation;
			if (sBrightness > kMaximumBrightness) {
				sBrightness = 0;
			}
		} else if (sBrightness > kOnePercentBrightnessApproximation) {
			sBrightness -= kOnePercentBrightnessApproximation;
		} else {
			sBrightness = 0;
		}
		data->Value = (uint8_t)sBrightness;
		Nrf::Matter::BindingHandler::RunBoundClusterAction(data);
	}
}

void LightSwitch::SwitchChangedHandler(const Binding::TableEntry &binding, OperationalDeviceProxy *deviceProxy,
				       Nrf::Matter::BindingHandler::BindingData &bindingData)
{
	if (binding.type == Binding::MATTER_MULTICAST_BINDING) {
		switch (bindingData.ClusterId) {
		case Clusters::OnOff::Id:
			OnOffProcessCommand(bindingData.CommandId, binding, nullptr, bindingData);
			break;
		case Clusters::LevelControl::Id:
			LevelControlProcessCommand(bindingData.CommandId, binding, nullptr, bindingData);
			break;
		default:
			ChipLogError(NotSpecified, "Invalid binding group command data");
			break;
		}
	} else if (binding.type == Binding::MATTER_UNICAST_BINDING) {
		switch (bindingData.ClusterId) {
		case Clusters::OnOff::Id:
			OnOffProcessCommand(bindingData.CommandId, binding, deviceProxy, bindingData);
			break;
		case Clusters::LevelControl::Id:
			LevelControlProcessCommand(bindingData.CommandId, binding, deviceProxy, bindingData);
			break;
		default:
			ChipLogError(NotSpecified, "Invalid binding unicast command data");
			break;
		}
	}
}

void LightSwitch::OnOffProcessCommand(CommandId commandId, const Binding::TableEntry &binding,
				      OperationalDeviceProxy *device,
				      Nrf::Matter::BindingHandler::BindingData &bindingData)
{
	CHIP_ERROR ret = CHIP_NO_ERROR;

	auto onSuccess = [dataPointer = Platform::New<Nrf::Matter::BindingHandler::BindingData>(bindingData)](
				 const ConcreteCommandPath &commandPath, const StatusIB &status,
				 const auto &dataResponse) {
		Nrf::Matter::BindingHandler::OnInvokeCommandSucces(dataPointer);
	};

	auto onFailure = [dataPointer = Platform::New<Nrf::Matter::BindingHandler::BindingData>(bindingData)](
				 CHIP_ERROR aError) mutable {
		Nrf::Matter::BindingHandler::OnInvokeCommandFailure(dataPointer, aError);
	};

	if (device) {
		/* We are validating connection is ready once here instead of multiple times in each case
		 * statement below. */
		VerifyOrDie(device->ConnectionReady());
	}

	switch (commandId) {
	case Clusters::OnOff::Commands::Toggle::Id:
		Clusters::OnOff::Commands::Toggle::Type toggleCommand;
		if (device) {
			ret = Controller::InvokeCommandRequest(device->GetExchangeManager(),
							       device->GetSecureSession().Value(), binding.remote,
							       toggleCommand, onSuccess, onFailure);
		} else {
			Messaging::ExchangeManager &exchangeMgr = Server::GetInstance().GetExchangeManager();
			ret = Controller::InvokeGroupCommandRequest(&exchangeMgr, binding.fabricIndex, binding.groupId,
								    toggleCommand);
		}
		break;

	case Clusters::OnOff::Commands::On::Id:
		Clusters::OnOff::Commands::On::Type onCommand;
		if (device) {
			ret = Controller::InvokeCommandRequest(device->GetExchangeManager(),
							       device->GetSecureSession().Value(), binding.remote,
							       onCommand, onSuccess, onFailure);
		} else {
			Messaging::ExchangeManager &exchangeMgr = Server::GetInstance().GetExchangeManager();
			ret = Controller::InvokeGroupCommandRequest(&exchangeMgr, binding.fabricIndex, binding.groupId,
								    onCommand);
		}
		break;

	case Clusters::OnOff::Commands::Off::Id:
		Clusters::OnOff::Commands::Off::Type offCommand;
		if (device) {
			ret = Controller::InvokeCommandRequest(device->GetExchangeManager(),
							       device->GetSecureSession().Value(), binding.remote,
							       offCommand, onSuccess, onFailure);
		} else {
			Messaging::ExchangeManager &exchangeMgr = Server::GetInstance().GetExchangeManager();
			ret = Controller::InvokeGroupCommandRequest(&exchangeMgr, binding.fabricIndex, binding.groupId,
								    offCommand);
		}
		break;
	default:
		LOG_DBG("Invalid binding command data - commandId is not supported");
		break;
	}
	if (CHIP_NO_ERROR != ret) {
		LOG_ERR("Invoke OnOff Command Request ERROR: %s", ErrorStr(ret));
	}
}

void LightSwitch::LevelControlProcessCommand(CommandId commandId, const Binding::TableEntry &binding,
					     OperationalDeviceProxy *device,
					     Nrf::Matter::BindingHandler::BindingData &bindingData)
{
	auto onSuccess = [dataPointer = Platform::New<Nrf::Matter::BindingHandler::BindingData>(bindingData)](
				 const ConcreteCommandPath &commandPath, const StatusIB &status,
				 const auto &dataResponse) {
		Nrf::Matter::BindingHandler::OnInvokeCommandSucces(dataPointer);
	};

	auto onFailure = [dataPointer = Platform::New<Nrf::Matter::BindingHandler::BindingData>(bindingData)](
				 CHIP_ERROR aError) mutable {
		Nrf::Matter::BindingHandler::OnInvokeCommandFailure(dataPointer, aError);
	};

	CHIP_ERROR ret = CHIP_NO_ERROR;

	if (device) {
		/* We are validating connection is ready once here instead of multiple times in each case
		 * statement below.
		 */
		VerifyOrDie(device->ConnectionReady());
	}

	switch (commandId) {
	case Clusters::LevelControl::Commands::MoveToLevel::Id: {
		Clusters::LevelControl::Commands::MoveToLevel::Type moveToLevelCommand;
		moveToLevelCommand.level = bindingData.Value;
		if (device) {
			ret = Controller::InvokeCommandRequest(device->GetExchangeManager(),
							       device->GetSecureSession().Value(), binding.remote,
							       moveToLevelCommand, onSuccess, onFailure);
		} else {
			Messaging::ExchangeManager &exchangeMgr = Server::GetInstance().GetExchangeManager();
			ret = Controller::InvokeGroupCommandRequest(&exchangeMgr, binding.fabricIndex, binding.groupId,
								    moveToLevelCommand);
		}
	} break;
	default:
		LOG_DBG("Invalid binding command data - commandId is not supported");
		break;
	}
	if (CHIP_NO_ERROR != ret) {
		LOG_ERR("Invoke Group Command Request ERROR: %s", ErrorStr(ret));
	}
}
```

## src/light_switch.h
```c
/*
 * Copyright (c) 2022 Nordic Semiconductor ASA
 *
 * SPDX-License-Identifier: LicenseRef-Nordic-5-Clause
 */

#pragma once
#include <app/util/basic-types.h>
#include <lib/core/CHIPError.h>

#include "binding/binding_handler.h"

#include <atomic>

/** @class LightSwitch
 *  @brief Class for controlling a CHIP light bulb over a Thread network
 *
 *  Features:
 *  - discovering a CHIP light bulb which advertises itself by sending Thread multicast packets
 *  - toggling and dimming the connected CHIP light bulb by sending appropriate CHIP messages
 */
class LightSwitch {
public:
	enum class Action : uint8_t {
		Toggle, /* Switch state on lighting-app device */
		On, /* Turn on light on lighting-app device */
		Off /* Turn off light on lighting-app device */
	};

	void Init(chip::EndpointId lightSwitchEndpoint);
	void InitiateActionSwitch(Action action);
	void DimmerChangeBrightness(bool increase = true);
	chip::EndpointId GetLightSwitchEndpointId() { return mLightSwitchEndpoint; }
	static void SwitchChangedHandler(const chip::app::Clusters::Binding::TableEntry &binding,
					 chip::OperationalDeviceProxy *deviceProxy,
					 Nrf::Matter::BindingHandler::BindingData &bindingData);

	static LightSwitch &GetInstance()
	{
		static LightSwitch sLightSwitch;
		return sLightSwitch;
	}

private:
	static void OnOffProcessCommand(chip::CommandId commandId,
					const chip::app::Clusters::Binding::TableEntry &binding,
					chip::OperationalDeviceProxy *device,
					Nrf::Matter::BindingHandler::BindingData &bindingData);
	static void LevelControlProcessCommand(chip::CommandId commandId,
					       const chip::app::Clusters::Binding::TableEntry &binding,
					       chip::OperationalDeviceProxy *device,
					       Nrf::Matter::BindingHandler::BindingData &bindingData);
	constexpr static auto kOnePercentBrightnessApproximation = 3;
	constexpr static auto kMaximumBrightness = 254;

	chip::EndpointId mLightSwitchEndpoint;
};
```
